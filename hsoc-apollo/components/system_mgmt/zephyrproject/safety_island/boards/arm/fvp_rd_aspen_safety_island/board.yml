## hsoc-apollo/components/system_mgmt/zephyrproject/safety_island/boards/arm/fvp_rd_aspen_safety_island/board.yml
```yaml
# SPDX-FileCopyrightText: <text>Copyright 2025-2026 Arm Limited and/or its
# affiliates <open-source-office@arm.com></text>
#
# SPDX-License-Identifier: Apache-2.0
---
board:
  name: fvp_rd_aspen_safety_island_c1
  full_name: FVP Emulation FVP RD-Aspen Safety Island cluster 1
  vendor: arm
  socs:
    - name: fvp_aemv8r_aarch64
```

## hsoc-apollo/components/system_mgmt/zephyrproject/safety_island/drivers/pfdi/Kconfig
```kconfig
# SPDX-FileCopyrightText: <text>Copyright 2026 Arm Limited and/or its
# affiliates <open-source-office@arm.com></text>
#
# SPDX-License-Identifier: Apache-2.0

menuconfig PFDI_MODULE
	bool "Platform Fault Detection (PFDI) support"
	default n
	help
	  Enable support for the Platform Fault Detection Interface (PFDI).

if PFDI_MODULE

config PFDI_OOR_ENABLE
	bool "Enable PFDI Out-of-Reset Test"
	default y
	help
	  When enabled, the PFDI Out-of-Reset test is executed on each CPU,
	  including both primary and secondary CPUs, during out-of-reset.

	  The availability of this option depends on the integrated firmware
	  library.

config PFDI_FAILSAFE_RETURN
	bool "Return on failure instead of stopping"
	default y
	help
	  When enabled, the failsafe path returns a failure status to the
	  caller instead of stopping execution.

	  Availability of this option depends on the integrated firmware
	  library.

config PFDI_ONL_EVENT_TRIGGERED
	bool "Enable Online Event-Triggered (OLE) mode"
	default n
	help
	  In Online Event-Triggered (OLE) mode, PFDI runs periodically
	  without blocking higher-priority applications or events for an
	  extended duration.

	  Availability of this option depends on the integrated firmware
	  library.

config PFDI_NUM_ITER
	int "Number of iterations per execution"
	default 0
	range 0 255
	help
	  Specifies the number of iterations executed each time PFDI
	  is invoked.

	  If set to 0, all remaining iterations for all tests are
	  executed before returning.

config PFDI_INIT_PRIORITY
	int "PFDI initialization priority"
	default KERNEL_INIT_PRIORITY_DEFAULT
	help
	  Initialization priority for the PFDI provider device.

config PLAT_PFDI_POST_RUN_HOOK
	bool "Enable platform-specific post-run hook"
	default n
	help
	  Execute a platform-specific hook after each PFDI run.

	  A custom platform hook, pfdi_post_run_hook(), is executed at
	  the end of pfdi_run(). Enabling this option requires the
	  platform to provide pfdi_post_run_hook()

endif
```

## hsoc-apollo/components/system_mgmt/zephyrproject/safety_island/drivers/pfdi_agent/Kconfig
```kconfig
#
# SPDX-FileCopyrightText: <text>Copyright 2026 Arm Limited and/or its
# affiliates <open-source-office@arm.com></text>
#
# SPDX-License-Identifier: Apache-2.0

config PFDI_AGENT
	bool "PFDI Agent"
	default y
	depends on DT_HAS_ARM_PFDI_AGENT_ENABLED
	depends on MBOX
	help
	  Enable PFDI Agent for sending status from Safety Island
	  Cluster 1 to Cluster 0 via SCMI over MHUv3.

if PFDI_AGENT

config PFDI_AGENT_INIT_PRIORITY
	int "PFDI Agent init priority"
	default KERNEL_INIT_PRIORITY_DEFAULT
	help
	  PFDI Agent initialization priority.
	  Must be higher than mailbox driver priority.

module = PFDI_AGENT
module-str = pfdi_agent
source "subsys/logging/Kconfig.template.log_config"

endif # PFDI_AGENT
```

## hsoc-apollo/components/system_mgmt/zephyrproject/safety_island/subsys/pfdi/Kconfig
```kconfig
#
# SPDX-FileCopyrightText: <text>Copyright 2026 Arm Limited and/or its
# affiliates <open-source-office@arm.com></text>
#
# SPDX-License-Identifier: Apache-2.0

menuconfig PFDI_MGMT
	bool "Platform Fault Detection Subsystem (manager)"
	default y
	depends on PFDI_MODULE
	depends on (!SMP || SCHED_CPU_MASK)

if PFDI_MGMT

config PFDI_MGMT_INIT_PRIORITY
	int "PFDI mgmt init priority"
	default 40
	range 0 99
	help
	  SYS_INIT priority for the PFDI manager.

config PFDI_MGMT_PERIOD_MS
	int "Periodic run interval (ms)"
	default 60
	range 1 60000

config PFDI_MGMT_THREAD_STACK_SIZE
	int "Per-CPU thread stack size"
	default 2048
	range 512 8192

config PFDI_MGMT_LOG_LEVEL
	int "PFDI mgmt log level"
	default 3
	range 0 4
	help
	  0=Off
	  1=Error
	  2=Warn
	  3=Info,
	  4=Debug

config PFDI_MGMT_DEBUG
	bool "Enable PFDI management debug features"
	default n
	help
	  Enables additional debug/testing functionality for the PFDI
	  management layer.

config PFDI_USE_ARM_FW_LIB
	bool "Using Arm firmware library"
	default n
	help
	  Enable this option when the build integrates the Arm-provided
	  firmware library.

config PFDI_FW_METADATA
	hex "PFDI firmware metadata (packed 64-bit word)"
	help
	  Packed firmware metadata word.
	  Bit layout (low 32 bits used):
		[31:24]  Vendor ID      (8 bits)
		[23:20]  Reserved       (must be 0)
		[19:16]  Implementation (4 bits)
		[15:8]   Major version  (8 bits)
		[7:0]    Minor version  (8 bits)

	  Upper 32 bits must be 0.
	  Vendor ID 0x01 is RESERVED for Arm and must not be used by
	  external vendors.

config PFDI_MGMT_SHELL
	bool "Enable Platform Fault Detection Interface shell Utils"
	default y
	depends on SHELL
endif
```

## hsoc-apollo/yocto/meta-hsoc-apollo-bsp/conf/layer.conf
```bitbake
#
# SPDX-License-Identifier: MIT
#

BBPATH .= ":${LAYERDIR}"

BBFILES += "${LAYERDIR}/recipes-*/*/*.bb \
            ${LAYERDIR}/recipes-*/*/*.bbappend"

BBFILE_COLLECTIONS += "meta-hsoc-apollo-bsp"
BBFILE_PATTERN_meta-hsoc-apollo-bsp = "^${LAYERDIR}/"

LAYERDEPENDS_meta-hsoc-apollo-bsp = "core meta-zena-css-bsp"
LAYERSERIES_COMPAT_meta-hsoc-apollo-bsp = "walnascar"

HSOC_APOLLO_BASE := "${LAYERDIR}/../.."
HSOC_APOLLO_LINUX_SRC ?= "${HSOC_APOLLO_BASE}/components/primary_compute/linux"
HSOC_APOLLO_UBOOT_SRC ?= "${HSOC_APOLLO_BASE}/components/primary_compute/u-boot"
HSOC_APOLLO_TFA_SRC ?= "${HSOC_APOLLO_BASE}/components/primary_compute/trusted-firmware-a"
HSOC_APOLLO_TFM_SRC ?= "${HSOC_APOLLO_BASE}/components/system_mgmt/trusted-firmware-m"
ZENA_CSS_BSP_LAYER ?= "${HSOC_APOLLO_BASE}/../arm-zena-css/yocto/meta-zena-css-bsp"
```

## hsoc-apollo/yocto/meta-hsoc-apollo/conf/layer.conf
```bitbake
#
# SPDX-License-Identifier: MIT
#

# We have a conf and classes directory, add to BBPATH
BBPATH .= ":${LAYERDIR}"

# Register this layer collection
BBFILE_COLLECTIONS += "meta-hsoc-apollo"
BBFILE_PATTERN_meta-hsoc-apollo = "^${LAYERDIR}/"

LAYERDEPENDS_meta-hsoc-apollo = "\
    core \
    meta-arm-auto-solutions \
"
LAYERSERIES_COMPAT_meta-hsoc-apollo = "walnascar"

HSOC_APOLLO_REPO_DIRECTORY = "${LAYERDIR}/../../"
```

## hsoc-stack/components/system_mgmt/zephyrproject/safety_island/dts/bindings/pfdi_agent/arm,pfdi-agent.yaml
```yaml
# SPDX-FileCopyrightText: <text>Copyright 2026 Arm Limited and/or its
# affiliates <open-source-office@arm.com></text>
#
# SPDX-License-Identifier: Apache-2.0
---
description: |
  ARM PFDI Agent - Sends PFDI status to PFDI monitor software on the host.
  Uses SCMI protocol over MHUv3 doorbell with shared memory

compatible: "arm,pfdi-agent"

include: base.yaml

properties:
  mboxes:
    type: phandle-array
    required: true
    description: |
      Per-core mailbox phandle-array for MHUv3 communication.
      One entry per core, each specifying the MHU device and channel ID.
      Channel ID encodes (doorbell_channel * 32) + flag.

  shmem:
    type: phandle
    required: true
    description: Reference to shared memory region for SCMI payload
```

## scripts/build/buildroot-external/Config.in
```kconfig
source "$BR2_EXTERNAL_APOLLO_BSP_PATH/package/apollo-perf/Config.in"
source "$BR2_EXTERNAL_APOLLO_BSP_PATH/package/apollo-pfdi-bsp/Config.in"
```

## scripts/build/buildroot-external/package/apollo-perf/Config.in
```kconfig
config BR2_PACKAGE_APOLLO_PERF
	bool "apollo-perf"
	depends on BR2_TOOLCHAIN_HAS_SYNC_4
	depends on BR2_TOOLCHAIN_HAS_THREADS
	depends on !BR2_STATIC_LIBS
	select BR2_PACKAGE_ELFUTILS
	select BR2_PACKAGE_HOST_PYTHON3
	select BR2_PACKAGE_LIBCAP
	select BR2_PACKAGE_ZLIB
	select BR2_PACKAGE_ZSTD
	help
	  Build perf from the Apollo local Linux source without enabling the
	  Buildroot Linux kernel package.
```

## scripts/build/buildroot-external/package/apollo-pfdi-bsp/Config.in
```kconfig
config BR2_PACKAGE_APOLLO_PFDI_BSP
	bool "apollo-pfdi-bsp"
	depends on BR2_TOOLCHAIN_HAS_THREADS
	depends on !BR2_STATIC_LIBS
	help
	  Build the Apollo Platform Fault Detection Interface library and
	  BSP sample application from the source unpacked by Yocto.
```
